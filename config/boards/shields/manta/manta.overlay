/ {
  chosen {
    zmk,kscan = &kscan0;
  };

  kscan0: kscan_0 {
    compatible = "zmk,kscan-gpio-matrix";
    label = "KSCAN";
    diode-direction = "col2row";

    #define MATRIX_COL_PINS { F6, F7, B1, B3, B2, B6, B5, B4, E6, D7, C6, D4 }

    col-gpios
      = <&pro_micro 19 GPIO_ACTIVE_HIGH>
      , <&pro_micro 18 GPIO_ACTIVE_HIGH>
      , <&pro_micro 15 GPIO_ACTIVE_HIGH>
      , <&pro_micro 14 GPIO_ACTIVE_HIGH>
      , <&pro_micro 16 GPIO_ACTIVE_HIGH>
      , <&pro_micro 10 GPIO_ACTIVE_HIGH>
      , <&pro_micro 9 GPIO_ACTIVE_HIGH>
      , <&pro_micro 8 GPIO_ACTIVE_HIGH>
      , <&pro_micro 7 GPIO_ACTIVE_HIGH>
      , <&pro_micro 6 GPIO_ACTIVE_HIGH>
      , <&pro_micro 5 GPIO_ACTIVE_HIGH>
      , <&pro_micro 4 GPIO_ACTIVE_HIGH>
      ;

    row-gpios
      = <&pro_micro 0 (GPIO_ACTIVE_HIGH | GPIO_PULL_DOWN)>
      , <&pro_micro 21 (GPIO_ACTIVE_HIGH | GPIO_PULL_DOWN)>
      , <&pro_micro 20 (GPIO_ACTIVE_HIGH | GPIO_PULL_DOWN)>
      ;
  };
};
